## main/Kconfig.projbuild
```kconfig
menu "Example Configuration"
    config LV_MEM_SIZE_KILOBYTES
        int "Size of the memory used by `lv_mem_alloc` in kilobytes (>= 2kB)"
        default 48
    config BT_ENABLED
        bool "Select this option to enable Bluetooth"
        default y 

    config BT_BLE_50_FEATURES_SUPPORTED
        bool "Enabling this option activates BLE 5.0 features"
        default y 
        
    config BT_BLE_42_FEATURES_SUPPORTED
        bool "This enables BLE 4.2 features."
        default y 
    

endmenu


menu "Jinny Wireless"

config J_WIFI_SSID
    string "WiFi SSID"
    default ""

config J_WIFI_PASS
    string "WiFi Password"
    default ""

config J_WIFI_FALLBACK_CH
    int "Fallback WiFi/ESPNOW channel (used when SSID is empty or not connected)"
    range 1 13
    default 1

config J_NODE_ID
    int "Node ID (for ESPNOW addressing)"
    range 1 65535
    default 2

config J_ESPNOW_PEER_MAC
    string "ESPNOW peer MAC (aa:bb:cc:dd:ee:ff). Empty disables peer add."
    default ""

endmenu
```
